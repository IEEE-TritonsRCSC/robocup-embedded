/* USER CODE BEGIN Header */
/**
 ******************************************************************************
 * @file           : main.c
 * @brief          : Main program body
 ******************************************************************************
 * @attention
 *
 * Copyright (c) 2023 STMicroelectronics.
 * All rights reserved.
 *
 * This software is licensed under terms that can be found in the LICENSE file
 * in the root directory of this software component.
 * If no LICENSE file comes with this software, it is provided AS-IS.
 *
 ******************************************************************************
 */
/* USER CODE END Header */

/* Includes ------------------------------------------------------------------*/
/* USER CODE BEGIN Includes */
#include "main.h"
#include "can.h"
#include "dma.h"
#include "tim.h"
#include "usart.h"
#include "gpio.h"
#include "PID.h"
#include <limits.h>

// External UART handle (defined in usart.c, generated by CubeMX)
extern UART_HandleTypeDef huart4;
/* USER CODE END Includes */

/* Private typedef -----------------------------------------------------------*/
/* USER CODE BEGIN PTD */

/* USER CODE END PTD */

/* Private define ------------------------------------------------------------*/
/* USER CODE BEGIN PD */
#define MOTOR_COUNT 4

#define UART_RX_PAYLOAD_RUNTIME 9
#define UART_RX_PAYLOAD_PID 7
#define UART_RX_BUFFER_SIZE UART_RX_PAYLOAD_RUNTIME
#define UART_TX_BUFFER_SIZE 12  // reserved for transmit (unused today)
#define HEADER_BYTE_1 0xCA        // UART sync byte 1
#define HEADER_BYTE_2_RUNTIME 0xFE // UART sync byte 2 (runtime)
#define HEADER_BYTE_2_PID 0xEE     // UART sync byte 2 (PID tuning)
#define DRIBBLE_ON 0x01           // command flag for dribbler
#define PID_SCALE 1000.0f
#define PID_WHEEL_ALL 4
#define PID_WHEEL_ALL_ALT 0xFF

#define UART_RX_MODE_NONE 0
#define UART_RX_MODE_RUNTIME 1
#define UART_RX_MODE_PID 2

#define CONTROL_LOOP_DELAY_MS 10
#define TARGET_SCALE 100.0f
#define DRIBBLE_SCALE -100

// Ramp tuning: milliseconds per unit of target.
// Smaller values ramp faster; larger values ramp slower.
#define WHEEL_RAMP_MS_PER_UNIT 10.0f
#define DRIBBLER_RAMP_MS_PER_UNIT 2.0f

#define CAN_MOTOR_TX_STDID 0x200
#define CAN_DRIBBLER_TX_STDID 0x1FF
#define CAN_MOTOR_RX_STDID_BASE 0x201

#define REDUCTION_RATIO 36.0f
#define RPM_TO_RADS 0.10472f

#define PROPORTIONAL_GAIN 1000.0f
#define INTEGRAL_GAIN 0.0f
#define DERIVATIVE_GAIN 0.0f

#define RIGHT_GAIN_MULT 1.0f
#define LEFT_GAIN_MULT 0.9f

// Telemetry over UART -> ESP32 -> UDP.
#define TELEMETRY_ENABLED 1
#define TELEMETRY_PERIOD_MS 500
#define TELEMETRY_HEADER_1 0xFE
#define TELEMETRY_HEADER_2 0xED
#define TELEMETRY_PAYLOAD_SIZE 28
#define TELEMETRY_PACKET_SIZE 30

/* USER CODE END PD */

/* Private macro -------------------------------------------------------------*/
/* USER CODE BEGIN PM */

/* USER CODE END PM */

/* Private variables ---------------------------------------------------------*/
/* USER CODE BEGIN PV */

// CAN variables (tx/rx headers and data buffers).
CAN_TxHeaderTypeDef canTxHeader;  // Motors 1-4 (StdId 0x200)
CAN_TxHeaderTypeDef canTxHeader2; // Motor 5 (dribbler) (StdId 0x1FF)
CAN_RxHeaderTypeDef canRxHeader;
uint32_t canTxMailbox;
uint8_t CAN_TxData[8];
uint8_t CAN2_TxData[8];
uint8_t CAN_RxData[8];

// Motor feedback/control state (shared between ISR and main loop).
volatile uint8_t motor_idx;
volatile uint16_t angle_data[MOTOR_COUNT];
volatile float speed_data[MOTOR_COUNT];
volatile float torque_current_data[MOTOR_COUNT];
volatile float targetSpeeds[MOTOR_COUNT];
volatile int dribble_speed;
PID_TypeDef motor_pid[MOTOR_COUNT];

// Ramped setpoints used by the control loop.
static float ramped_target_speeds[MOTOR_COUNT];
static float ramped_dribbler_speed;
static uint32_t ramp_last_ms;

/*volatile float Kp1 = 0.503;
volatile float Ki1 = 0.005;
volatile float Kd1 = 0.00;
volatile float Kp2 = 0.3;
volatile float Ki2 = 0.0;
volatile float Kd2 = 0.00;
volatile float Kp3 = 0.273;
volatile float Ki3 = 0.0;
volatile float Kd3 = 0.00;
volatile float Kp4 = 0.403;
volatile float Ki4 = 0.0;
volatile float Kd4 = 0.00;*/

// PID limits and defaults.
const float INTEGRAL_LIMIT = 1000.0f;
const float MAXOUT = 3000.0f;
const float DEADBAND = 0.5f;
const float TARGET = 0.0f;

volatile float Kp1 = PROPORTIONAL_GAIN * RIGHT_GAIN_MULT; // front-right
volatile float Ki1 = INTEGRAL_GAIN;
volatile float Kd1 = DERIVATIVE_GAIN;

volatile float Kp2 = PROPORTIONAL_GAIN * RIGHT_GAIN_MULT; // back-right
volatile float Ki2 = INTEGRAL_GAIN;
volatile float Kd2 = DERIVATIVE_GAIN;

volatile float Kp3 = PROPORTIONAL_GAIN * LEFT_GAIN_MULT; // back-left
volatile float Ki3 = INTEGRAL_GAIN;
volatile float Kd3 = DERIVATIVE_GAIN;

volatile float Kp4 = PROPORTIONAL_GAIN * LEFT_GAIN_MULT; // front-left
volatile float Ki4 = INTEGRAL_GAIN;
volatile float Kd4 = DERIVATIVE_GAIN;

// UART setup (rx is interrupt-driven).
uint8_t uart_rx_buffer[UART_RX_BUFFER_SIZE];
uint8_t uart_tx_buffer[UART_TX_BUFFER_SIZE];
volatile uint8_t rx_byte = 0;
volatile int header1_flag = 0;
volatile int header2_flag = 0;
volatile uint8_t rx_mode = UART_RX_MODE_NONE;
volatile uint8_t rx_expected_length = 0;

// Telemetry TX state.
static uint8_t telemetry_tx_buffer[TELEMETRY_PACKET_SIZE];
static volatile uint8_t telemetry_tx_busy;
static uint32_t telemetry_last_ms;

// Safety timeout for comms loss (incremented in main loop).
volatile int timeout;

/* USER CODE END PV */

/* Private function prototypes -----------------------------------------------*/
void SystemClock_Config(void);
/* USER CODE BEGIN PFP */

// Application initialization and control loop.
static void app_init(void);
static void control_loop_step(void);

// Hardware/runtime setup helpers.
static void init_motor_power_pins(void);
static void init_can_headers(void);
static void init_pid_controllers(void);
static void init_feedback_buffers(void);
static void init_target_buffers(void);
static void init_status_leds(void);
static void init_uart_state(void);
static void start_uart_rx(void);

// CAN/UART parsing helpers.
static uint8_t motor_index_from_std_id(uint32_t std_id, uint8_t *out_index);
static void update_feedback_from_can(uint8_t index, const uint8_t data[8]);
static void apply_uart_packet(const uint8_t *payload);
static void apply_pid_packet(const uint8_t *payload);
static int16_t bytes_to_int16_be(const uint8_t *bytes);
static int16_t clamp_int16_from_float(float value);
static void telemetry_try_send(void);

// Utility helpers.
static void clear_buffer(uint8_t *buffer, uint32_t length);
static void split_int16(int16_t value, uint8_t *high, uint8_t *low);
static float ramp_linear(float current, float target, float ms_per_unit, float dt_ms);
static float ramp_get_dt_ms(void);
static void set_pid_for_wheel(uint8_t wheel, float kp, float ki, float kd);

/* USER CODE END PFP */

/* Private user code ---------------------------------------------------------*/
/* USER CODE BEGIN 0 */

// Clear a buffer to zero.
static void clear_buffer(uint8_t *buffer, uint32_t length)
{
	for (uint32_t i = 0; i < length; ++i) {
		buffer[i] = 0;
	}
}

// Split a signed 16-bit value into high/low bytes (big-endian).
static void split_int16(int16_t value, uint8_t *high, uint8_t *low)
{
	uint16_t uvalue = (uint16_t)value;
	*high = (uint8_t)((uvalue >> 8) & 0xFF);
	*low = (uint8_t)(uvalue & 0xFF);
}

// Combine two bytes into a signed 16-bit value (big-endian).
static int16_t bytes_to_int16_be(const uint8_t *bytes)
{
	return (int16_t)((bytes[0] << 8) | bytes[1]);
}

// Clamp and round a float into int16 range.
static int16_t clamp_int16_from_float(float value)
{
	if (value > (float)INT16_MAX) {
		return INT16_MAX;
	}
	if (value < (float)INT16_MIN) {
		return INT16_MIN;
	}
	if (value >= 0.0f) {
		value += 0.5f;
	} else {
		value -= 0.5f;
	}
	return (int16_t)value;
}

// Linear ramp limiter: advances current toward target at a fixed slope.
// ms_per_unit sets how many milliseconds it takes to change by 1 unit.
static float ramp_linear(float current, float target, float ms_per_unit, float dt_ms)
{
	if (ms_per_unit <= 0.0f) {
		return target;
	}

	if (dt_ms <= 0.0f) {
		return current;
	}

	float max_delta = dt_ms / ms_per_unit;
	float delta = target - current;

	if (delta > max_delta) {
		delta = max_delta;
	} else if (delta < -max_delta) {
		delta = -max_delta;
	}

	return current + delta;
}

// Compute elapsed time since last ramp update in milliseconds.
static float ramp_get_dt_ms(void)
{
	uint32_t now = HAL_GetTick();
	if (ramp_last_ms == 0) {
		ramp_last_ms = now;
		return 0.0f;
	}

	uint32_t dt_ms = now - ramp_last_ms;
	ramp_last_ms = now;
	return (float)dt_ms;
}

// Enable motor power pins on startup.
static void init_motor_power_pins(void)
{
	HAL_GPIO_TogglePin(MOTOR_PORT, MOTOR1_PIN);
	HAL_GPIO_TogglePin(MOTOR_PORT, MOTOR2_PIN);
	HAL_GPIO_TogglePin(MOTOR_PORT, MOTOR3_PIN);
	HAL_GPIO_TogglePin(MOTOR_PORT, MOTOR4_PIN);
	HAL_GPIO_TogglePin(MOTOR_PORT, MOTOR5_PIN);
}

// Configure CAN transmit headers for drivetrain and dribbler.
static void init_can_headers(void)
{
	canTxHeader.DLC = 8;
	canTxHeader.IDE = CAN_ID_STD;
	canTxHeader.RTR = CAN_RTR_DATA;
	canTxHeader.StdId = CAN_MOTOR_TX_STDID;
	canTxHeader.TransmitGlobalTime = DISABLE;

	canTxHeader2.DLC = 8;
	canTxHeader2.IDE = CAN_ID_STD;
	canTxHeader2.RTR = CAN_RTR_DATA;
	canTxHeader2.StdId = CAN_DRIBBLER_TX_STDID;
	canTxHeader2.TransmitGlobalTime = DISABLE;
}

// Initialize feedback buffers used by the control loop.
static void init_feedback_buffers(void)
{
	for (int i = 0; i < MOTOR_COUNT; ++i) {
		angle_data[i] = 0;
		speed_data[i] = 0.0f;
		torque_current_data[i] = 0.0f;
	}
}

// Initialize command/target buffers used by the control loop.
static void init_target_buffers(void)
{
	for (int i = 0; i < MOTOR_COUNT; ++i) {
		targetSpeeds[i] = 0.0f;
		ramped_target_speeds[i] = 0.0f;
	}
	dribble_speed = 0;
	ramped_dribbler_speed = 0.0f;
	ramp_last_ms = HAL_GetTick();
}

// Initialize PID controllers for each wheel.
static void init_pid_controllers(void)
{
	pid_init(&motor_pid[0], MAXOUT, INTEGRAL_LIMIT, DEADBAND, TARGET, Kp1, Ki1, Kd1);
	pid_init(&motor_pid[1], MAXOUT, INTEGRAL_LIMIT, DEADBAND, TARGET, Kp2, Ki2, Kd2);
	pid_init(&motor_pid[2], MAXOUT, INTEGRAL_LIMIT, DEADBAND, TARGET, Kp3, Ki3, Kd3);
	pid_init(&motor_pid[3], MAXOUT, INTEGRAL_LIMIT, DEADBAND, TARGET, Kp4, Ki4, Kd4);
}

// Initialize LEDs to off state.
static void init_status_leds(void)
{
	HAL_GPIO_WritePin(LED_GREEN_PORT, LED_GREEN_PIN, LED_OFF);
	HAL_GPIO_WritePin(LED_RED_PORT, LED_RED_PIN, LED_OFF);
}

// Initialize UART state machine and buffers.
static void init_uart_state(void)
{
	rx_byte = 0;
	header1_flag = 0;
	header2_flag = 0;
	rx_mode = UART_RX_MODE_NONE;
	rx_expected_length = 0;
	timeout = 0;
	telemetry_tx_busy = 0;
	telemetry_last_ms = 0;
	clear_buffer(uart_rx_buffer, UART_RX_BUFFER_SIZE);
	clear_buffer(uart_tx_buffer, UART_TX_BUFFER_SIZE);
}

// Begin receiving UART bytes via interrupt.
static void start_uart_rx(void)
{
	HAL_UART_Receive_IT(&huart4, &rx_byte, 1);
}

// One-time application setup.
static void app_init(void)
{
	init_motor_power_pins();
	init_can_headers();
	init_feedback_buffers();
	init_target_buffers();
	init_pid_controllers();
	init_status_leds();
	init_uart_state();
	start_uart_rx();
}

// Convert CAN StdId into motor index (0..MOTOR_COUNT-1).
static uint8_t motor_index_from_std_id(uint32_t std_id, uint8_t *out_index)
{
	if (std_id < CAN_MOTOR_RX_STDID_BASE
			|| std_id >= (CAN_MOTOR_RX_STDID_BASE + MOTOR_COUNT)) {
		return 0;
	}
	*out_index = (uint8_t)(std_id - CAN_MOTOR_RX_STDID_BASE);
	return 1;
}

// Update feedback arrays from a CAN RX payload.
static void update_feedback_from_can(uint8_t index, const uint8_t data[8])
{
	if (index >= MOTOR_COUNT) {
		return;
	}

	// Angle of the motor (0 - 8191 corresponding with 0 - 360 degrees).
	angle_data[index] = (uint16_t) (data[0] << 8 | data[1]);

	// Speed of the motor in rpm, converted to rad/s after gear reduction.
	int16_t rpm = (int16_t)((data[2] << 8) | data[3]);
	speed_data[index] = (rpm / REDUCTION_RATIO) * RPM_TO_RADS;

	// Torque current of the motor (raw units).
	torque_current_data[index] = (float)((data[4] << 8) | data[5]);
}

// Apply a full UART payload (already stripped of header bytes).
static void apply_uart_packet(const uint8_t *payload)
{
	targetSpeeds[0] = (float)bytes_to_int16_be(&payload[0]);
	targetSpeeds[1] = (float)bytes_to_int16_be(&payload[2]);
	targetSpeeds[2] = (float)bytes_to_int16_be(&payload[4]);
	targetSpeeds[3] = (float)bytes_to_int16_be(&payload[6]);
	// Optional tuning: boost front-right wheel (disabled by default).
	// targetSpeeds[0] = targetSpeeds[0] * 1.15f;
	// Historical note: |targetSpeeds[i]| was previously limited to 500.
	dribble_speed = (int8_t)payload[8];
}

// Update PID gains from a tuning packet payload.
static void apply_pid_packet(const uint8_t *payload)
{
	uint8_t wheel = payload[0];
	int16_t kp_q = bytes_to_int16_be(&payload[1]);
	int16_t ki_q = bytes_to_int16_be(&payload[3]);
	int16_t kd_q = bytes_to_int16_be(&payload[5]);

	float kp = ((float)kp_q) / PID_SCALE;
	float ki = ((float)ki_q) / PID_SCALE;
	float kd = ((float)kd_q) / PID_SCALE;

	if (wheel == PID_WHEEL_ALL || wheel == PID_WHEEL_ALL_ALT) {
		for (uint8_t i = 0; i < MOTOR_COUNT; ++i) {
			set_pid_for_wheel(i, kp, ki, kd);
		}
		return;
	}

	set_pid_for_wheel(wheel, kp, ki, kd);
}

// One iteration of the main control loop.
static void control_loop_step(void)
{
	float dt_ms = ramp_get_dt_ms();
	
	// Safety timeout when UART disconnects (uncomment if needed).
	if (timeout >= 200) {
		for (int i = 0; i < MOTOR_COUNT; ++i) {
			targetSpeeds[i] = 0.0f;
		}
	}
	

	for (int i = 0; i < MOTOR_COUNT; ++i) {
		// Target speeds arrive in centi-units; scale to match feedback units.
		float target = ((float)targetSpeeds[i]) / TARGET_SCALE;
		// Ramp the target to avoid instant changes.
		ramped_target_speeds[i] = ramp_linear(ramped_target_speeds[i], target,
				WHEEL_RAMP_MS_PER_UNIT, dt_ms);
		motor_pid[i].target = ramped_target_speeds[i];
		pid_calculate(&motor_pid[i], speed_data[i]);
	}

	// Ramp the dribbler command as well.
	float dribbler_target = (float)dribble_speed * DRIBBLE_SCALE;
	ramped_dribbler_speed = ramp_linear(ramped_dribbler_speed, dribbler_target,
			DRIBBLER_RAMP_MS_PER_UNIT, dt_ms);

	setMotorSpeeds((int16_t)motor_pid[0].output,
			(int16_t)motor_pid[1].output,
			(int16_t)motor_pid[2].output,
			(int16_t)motor_pid[3].output,
			(int16_t)ramped_dribbler_speed);

	timeout++;
}

// Send telemetry at a fixed rate without blocking the control loop.
static void telemetry_try_send(void)
{
#if TELEMETRY_ENABLED
	if (telemetry_tx_busy) {
		return;
	}

	uint32_t now = HAL_GetTick();
	if ((now - telemetry_last_ms) < TELEMETRY_PERIOD_MS) {
		return;
	}

	telemetry_tx_buffer[0] = TELEMETRY_HEADER_1;
	telemetry_tx_buffer[1] = TELEMETRY_HEADER_2;
	telemetry_tx_buffer[2] = (uint8_t)((now >> 24) & 0xFF);
	telemetry_tx_buffer[3] = (uint8_t)((now >> 16) & 0xFF);
	telemetry_tx_buffer[4] = (uint8_t)((now >> 8) & 0xFF);
	telemetry_tx_buffer[5] = (uint8_t)(now & 0xFF);

	uint8_t *payload = &telemetry_tx_buffer[6];
	for (int i = 0; i < MOTOR_COUNT; ++i) {
		int16_t target = clamp_int16_from_float(motor_pid[i].target * TARGET_SCALE);
		int16_t actual = clamp_int16_from_float(speed_data[i] * TARGET_SCALE);
		int16_t output = clamp_int16_from_float(motor_pid[i].output);

		split_int16(target, &payload[0], &payload[1]);
		split_int16(actual, &payload[2], &payload[3]);
		split_int16(output, &payload[4], &payload[5]);
		payload += 6;
	}

	if (HAL_UART_Transmit_IT(&huart4, telemetry_tx_buffer, TELEMETRY_PACKET_SIZE) == HAL_OK) {
		telemetry_tx_busy = 1;
		telemetry_last_ms = now;
	}
#endif
}

// Update PID gains for a single wheel and keep shadow variables in sync.
static void set_pid_for_wheel(uint8_t wheel, float kp, float ki, float kd)
{
	if (wheel >= MOTOR_COUNT) {
		return;
	}

	switch (wheel) {
	case 0:
		Kp1 = kp;
		Ki1 = ki;
		Kd1 = kd;
		break;
	case 1:
		Kp2 = kp;
		Ki2 = ki;
		Kd2 = kd;
		break;
	case 2:
		Kp3 = kp;
		Ki3 = ki;
		Kd3 = kd;
		break;
	case 3:
		Kp4 = kp;
		Ki4 = ki;
		Kd4 = kd;
		break;
	default:
		return;
	}

	pid_set_constants(&motor_pid[wheel], kp, ki, kd);
}

/* USER CODE END 0 */

/**
 * @brief  The application entry point.
 * @retval int
 */

int main(void) {
	/* USER CODE BEGIN 1 */
	/* USER CODE END 1 */

	/* MCU Configuration--------------------------------------------------------*/

	/* Reset of all peripherals, Initializes the Flash interface and the Systick. */
	HAL_Init();

	/* USER CODE BEGIN Init */

	/* USER CODE END Init */

	/* Configure the system clock */
	SystemClock_Config();

	/* USER CODE BEGIN SysInit */

	/* USER CODE END SysInit */
	//printf("Hello SWV!\r\n");
	/* Initialize all configured peripherals */
	MX_GPIO_Init();
	MX_DMA_Init();
	MX_CAN1_Init();
	MX_TIM1_Init();
	MX_UART4_Init();
	/* USER CODE BEGIN 2 */
	// Initialize runtime state and start peripherals.
	app_init();

	/* USER CODE END 2 */

	/* Infinite loop */
	/* USER CODE BEGIN WHILE */
	while (1) {
		// Main control loop iteration.
		control_loop_step();
		telemetry_try_send();
		HAL_Delay(CONTROL_LOOP_DELAY_MS);
		/* USER CODE END WHILE */

		/* USER CODE BEGIN 3 */
		/* USER CODE END 3 */
	}
}

void HAL_CAN_RxFifo0MsgPendingCallback(CAN_HandleTypeDef *hcan) {
	//HAL_GPIO_TogglePin(LED_GREEN_PORT,LED_GREEN_PIN);
	if (hcan != &hcan1) {
		return;
	}

	// Read the incoming CAN message.
	if (HAL_CAN_GetRxMessage(&hcan1, CAN_RX_FIFO0, &canRxHeader, CAN_RxData) != HAL_OK) {
		return;
	}

	// Map StdId to motor index and update feedback buffers.
	uint8_t index = 0;
	if (!motor_index_from_std_id(canRxHeader.StdId, &index)) {
		return;
	}

	motor_idx = index;
	update_feedback_from_can(index, CAN_RxData);
}


void HAL_UART_RxCpltCallback(UART_HandleTypeDef *huart) {
	(void)huart;
	// Called when a byte or the full UART payload has been received.

	if (!header1_flag) {
		if (rx_byte == HEADER_BYTE_1) {
			// First header byte received.
			header1_flag = 1;
		}
		HAL_UART_Receive_IT(&huart4, &rx_byte, 1);
		return;
	}

	if (header2_flag) {
		// Full message received.
		timeout = 0;

		if (rx_mode == UART_RX_MODE_RUNTIME) {
			apply_uart_packet(uart_rx_buffer);
		} else if (rx_mode == UART_RX_MODE_PID) {
			apply_pid_packet(uart_rx_buffer);
		}
		clear_buffer(uart_rx_buffer, UART_RX_BUFFER_SIZE);
		HAL_GPIO_TogglePin(LED_GREEN_PORT, LED_GREEN_PIN);

		header1_flag = 0;
		header2_flag = 0;
		rx_mode = UART_RX_MODE_NONE;
		rx_expected_length = 0;
		HAL_UART_Receive_IT(&huart4, &rx_byte, 1);
		return;
	}

	if (rx_byte == HEADER_BYTE_2_RUNTIME) {
		// Second header byte received; read full payload.
		header2_flag = 1;
		rx_mode = UART_RX_MODE_RUNTIME;
		rx_expected_length = UART_RX_PAYLOAD_RUNTIME;
		HAL_UART_Receive_IT(&huart4, uart_rx_buffer, rx_expected_length);
		return;
	}

	if (rx_byte == HEADER_BYTE_2_PID) {
		// PID tuning packet received; read tuning payload.
		header2_flag = 1;
		rx_mode = UART_RX_MODE_PID;
		rx_expected_length = UART_RX_PAYLOAD_PID;
		HAL_UART_Receive_IT(&huart4, uart_rx_buffer, rx_expected_length);
		return;
	}

	// Header mismatch; reset and look for the first header byte again.
	header1_flag = 0;
	HAL_UART_Receive_IT(&huart4, &rx_byte, 1);
}

void HAL_UART_TxCpltCallback(UART_HandleTypeDef *huart) {
	if (huart == &huart4) {
		telemetry_tx_busy = 0;
	}
}


/**
 * @brief System Clock Configuration
 * @retval None
 */
void SystemClock_Config(void) {
	RCC_OscInitTypeDef RCC_OscInitStruct = { 0 };
	RCC_ClkInitTypeDef RCC_ClkInitStruct = { 0 };

	/** Configure the main internal regulator output voltage
	 */
	__HAL_RCC_PWR_CLK_ENABLE();
	__HAL_PWR_VOLTAGESCALING_CONFIG(PWR_REGULATOR_VOLTAGE_SCALE1);

	/** Initializes the RCC Oscillators according to the specified parameters
	 * in the RCC_OscInitTypeDef structure.
	 */
	RCC_OscInitStruct.OscillatorType = RCC_OSCILLATORTYPE_HSE;
	RCC_OscInitStruct.HSEState = RCC_HSE_ON;
	RCC_OscInitStruct.PLL.PLLState = RCC_PLL_ON;
	RCC_OscInitStruct.PLL.PLLSource = RCC_PLLSOURCE_HSE;
	RCC_OscInitStruct.PLL.PLLM = 6;
	RCC_OscInitStruct.PLL.PLLN = 168;
	RCC_OscInitStruct.PLL.PLLP = RCC_PLLP_DIV2;
	RCC_OscInitStruct.PLL.PLLQ = 4;
	if (HAL_RCC_OscConfig(&RCC_OscInitStruct) != HAL_OK) {
		Error_Handler();
	}

	/** Initializes the CPU, AHB and APB buses clocks
	 */
	RCC_ClkInitStruct.ClockType = RCC_CLOCKTYPE_HCLK | RCC_CLOCKTYPE_SYSCLK
			| RCC_CLOCKTYPE_PCLK1 | RCC_CLOCKTYPE_PCLK2;
	RCC_ClkInitStruct.SYSCLKSource = RCC_SYSCLKSOURCE_PLLCLK;
	RCC_ClkInitStruct.AHBCLKDivider = RCC_SYSCLK_DIV1;
	RCC_ClkInitStruct.APB1CLKDivider = RCC_HCLK_DIV4;
	RCC_ClkInitStruct.APB2CLKDivider = RCC_HCLK_DIV2;

	if (HAL_RCC_ClockConfig(&RCC_ClkInitStruct, FLASH_LATENCY_5) != HAL_OK) {
		Error_Handler();
	}
}

/* USER CODE BEGIN 4 */
void setMotorSpeeds(int16_t ms1, int16_t ms2, int16_t ms3, int16_t ms4, int16_t msg5) {
	uint8_t h1 = 0, l1 = 0;
	uint8_t h2 = 0, l2 = 0;
	uint8_t h3 = 0, l3 = 0;
	uint8_t h4 = 0, l4 = 0;
	uint8_t h5 = 0, l5 = 0;

	// Split each command into high/low bytes for CAN.
	split_int16(ms1, &h1, &l1);
	split_int16(ms2, &h2, &l2);
	split_int16(ms3, &h3, &l3);
	split_int16(ms4, &h4, &l4);
	split_int16(msg5, &h5, &l5);

	runMotors(h1, l1, h2, l2, h3, l3, h4, l4, h5, l5);
}

void runMotors(uint8_t motorOneHigh, uint8_t motorOneLow,
		uint8_t motorTwoHigh, uint8_t motorTwoLow,
		uint8_t motorThreeHigh, uint8_t motorThreeLow,
		uint8_t motorFourHigh, uint8_t motorFourLow,
		uint8_t motorFiveHigh, uint8_t motorFiveLow) {

	// Speed commands are 16-bit values split into high/low bytes.
	CAN_TxData[0] = motorOneHigh;
	CAN_TxData[1] = motorOneLow;
	CAN_TxData[2] = motorTwoHigh;
	CAN_TxData[3] = motorTwoLow;
	CAN_TxData[4] = motorThreeHigh;
	CAN_TxData[5] = motorThreeLow;
	CAN_TxData[6] = motorFourHigh;
	CAN_TxData[7] = motorFourLow;

	CAN2_TxData[0] = motorFiveHigh;
	CAN2_TxData[1] = motorFiveLow;
	for (int i = 2; i < 8; ++i) {
		CAN2_TxData[i] = 0;
	}

	HAL_CAN_AddTxMessage(&hcan1, &canTxHeader, CAN_TxData, &canTxMailbox);
	HAL_CAN_AddTxMessage(&hcan1, &canTxHeader2, CAN2_TxData, &canTxMailbox);
}

/* USER CODE END 4 */

/**
 * @brief  Period elapsed callback in non blocking mode
 * @note   This function is called  when TIM6 interrupt took place, inside
 * HAL_TIM_IRQHandler(). It makes a direct call to HAL_IncTick() to increment
 * a global variable "uwTick" used as application time base.
 * @param  htim : TIM handle
 * @retval None
 */
void HAL_TIM_PeriodElapsedCallback(TIM_HandleTypeDef *htim) {
	/* USER CODE BEGIN Callback 0 */

	/* USER CODE END Callback 0 */
	if (htim->Instance == TIM6) {
		HAL_IncTick();
	}
	/* USER CODE BEGIN Callback 1 */

	/* USER CODE END Callback 1 */
}

/**
 * @brief  This function is executed in case of error occurrence.
 * @retval None
 */
void Error_Handler(void) {
	/* USER CODE BEGIN Error_Handler_Debug */
	/* User can add his own implementation to report the HAL error return state */
	__disable_irq();
	while (1) {
	}
	/* USER CODE END Error_Handler_Debug */
}

#ifdef  USE_FULL_ASSERT
/**
  * @brief  Reports the name of the source file and the source line number
  *         where the assert_param error has occurred.
  * @param  file: pointer to the source file name
  * @param  line: assert_param error line source number
  * @retval None
  */
void assert_failed(uint8_t *file, uint32_t line)
{
  /* USER CODE BEGIN 6 */
  /* User can add his own implementation to report the file name and line number,
     ex: printf("Wrong parameters value: file %s on line %d\r\n", file, line) */
  /* USER CODE END 6 */
}
#endif /* USE_FULL_ASSERT */
